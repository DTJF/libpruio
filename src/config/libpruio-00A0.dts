// dts file auto generated by pruio_config (don't edit)
/dts-v1/;
/plugin/;

/ {
    compatible = "ti,beaglebone", "ti,beaglebone-black";

    /* identification */
    board-name = "libpruio";
    manufacturer = "TJF";
    part-number = "PruIoBBB";
    version = "00A0";

    /* state the resources this cape uses */
    exclusive-use =
      "P8.19",
      "P8.13",
      "P8.14",
      "P8.17",
      "P8.12",
      "P8.11",
      "P8.16",
      "P8.15",
      "P9.15",
      "P9.23",
      "P9.14",
      "P9.16",
      "P9.11",
      "P9.13",
      "P9.12",
      "P8.26",
      "P8.18",
      "P8.07",
      "P8.08",
      "P8.10",
      "P8.09",
      "P9.22",
      "P9.21",
      "P9.42",
      "P9.26",
      "P9.24",
      "P9.30",
      "P9.27",
      "P9.41",
      "pruss";

    fragment@0 {
      target = <&am33xx_pinmux>;
      __overlay__ {
        B08_28: 08_28 {pinctrl-single,pins = <0x020 0x28>;};
        B08_09: 08_09 {pinctrl-single,pins = <0x020 0x09>;};
        B08_2A: 08_2A {pinctrl-single,pins = <0x020 0x2A>;};
        B08_2B: 08_2B {pinctrl-single,pins = <0x020 0x2B>;};
        B08_0C: 08_0C {pinctrl-single,pins = <0x020 0x0C>;};
        B08_25: 08_25 {pinctrl-single,pins = <0x020 0x25>;};
        B08_2F: 08_2F {pinctrl-single,pins = <0x020 0x2F>;};
        B08_37: 08_37 {pinctrl-single,pins = <0x020 0x37>;};
        B08_27: 08_27 {pinctrl-single,pins = <0x020 0x27>;};
        B08_0F: 08_0F {pinctrl-single,pins = <0x020 0x0F>;};
        B09_28: 09_28 {pinctrl-single,pins = <0x024 0x28>;};
        B09_09: 09_09 {pinctrl-single,pins = <0x024 0x09>;};
        B09_2A: 09_2A {pinctrl-single,pins = <0x024 0x2A>;};
        B09_2B: 09_2B {pinctrl-single,pins = <0x024 0x2B>;};
        B09_0C: 09_0C {pinctrl-single,pins = <0x024 0x0C>;};
        B09_25: 09_25 {pinctrl-single,pins = <0x024 0x25>;};
        B09_2F: 09_2F {pinctrl-single,pins = <0x024 0x2F>;};
        B09_37: 09_37 {pinctrl-single,pins = <0x024 0x37>;};
        B09_27: 09_27 {pinctrl-single,pins = <0x024 0x27>;};
        B09_0F: 09_0F {pinctrl-single,pins = <0x024 0x0F>;};
        B0A_28: 0A_28 {pinctrl-single,pins = <0x028 0x28>;};
        B0A_09: 0A_09 {pinctrl-single,pins = <0x028 0x09>;};
        B0A_2A: 0A_2A {pinctrl-single,pins = <0x028 0x2A>;};
        B0A_2B: 0A_2B {pinctrl-single,pins = <0x028 0x2B>;};
        B0A_24: 0A_24 {pinctrl-single,pins = <0x028 0x24>;};
        B0A_0D: 0A_0D {pinctrl-single,pins = <0x028 0x0D>;};
        B0A_2F: 0A_2F {pinctrl-single,pins = <0x028 0x2F>;};
        B0A_37: 0A_37 {pinctrl-single,pins = <0x028 0x37>;};
        B0A_27: 0A_27 {pinctrl-single,pins = <0x028 0x27>;};
        B0A_0F: 0A_0F {pinctrl-single,pins = <0x028 0x0F>;};
        B0B_28: 0B_28 {pinctrl-single,pins = <0x02C 0x28>;};
        B0B_09: 0B_09 {pinctrl-single,pins = <0x02C 0x09>;};
        B0B_2A: 0B_2A {pinctrl-single,pins = <0x02C 0x2A>;};
        B0B_2B: 0B_2B {pinctrl-single,pins = <0x02C 0x2B>;};
        B0B_0C: 0B_0C {pinctrl-single,pins = <0x02C 0x0C>;};
        B0B_0D: 0B_0D {pinctrl-single,pins = <0x02C 0x0D>;};
        B0B_2F: 0B_2F {pinctrl-single,pins = <0x02C 0x2F>;};
        B0B_37: 0B_37 {pinctrl-single,pins = <0x02C 0x37>;};
        B0B_27: 0B_27 {pinctrl-single,pins = <0x02C 0x27>;};
        B0B_0F: 0B_0F {pinctrl-single,pins = <0x02C 0x0F>;};
        B0C_28: 0C_28 {pinctrl-single,pins = <0x030 0x28>;};
        B0C_09: 0C_09 {pinctrl-single,pins = <0x030 0x09>;};
        B0C_2A: 0C_2A {pinctrl-single,pins = <0x030 0x2A>;};
        B0C_2B: 0C_2B {pinctrl-single,pins = <0x030 0x2B>;};
        B0C_24: 0C_24 {pinctrl-single,pins = <0x030 0x24>;};
        B0C_0D: 0C_0D {pinctrl-single,pins = <0x030 0x0D>;};
        B0C_0E: 0C_0E {pinctrl-single,pins = <0x030 0x0E>;};
        B0C_2F: 0C_2F {pinctrl-single,pins = <0x030 0x2F>;};
        B0C_37: 0C_37 {pinctrl-single,pins = <0x030 0x37>;};
        B0C_27: 0C_27 {pinctrl-single,pins = <0x030 0x27>;};
        B0C_0F: 0C_0F {pinctrl-single,pins = <0x030 0x0F>;};
        B0D_28: 0D_28 {pinctrl-single,pins = <0x034 0x28>;};
        B0D_09: 0D_09 {pinctrl-single,pins = <0x034 0x09>;};
        B0D_2A: 0D_2A {pinctrl-single,pins = <0x034 0x2A>;};
        B0D_2B: 0D_2B {pinctrl-single,pins = <0x034 0x2B>;};
        B0D_24: 0D_24 {pinctrl-single,pins = <0x034 0x24>;};
        B0D_0D: 0D_0D {pinctrl-single,pins = <0x034 0x0D>;};
        B0D_0E: 0D_0E {pinctrl-single,pins = <0x034 0x0E>;};
        B0D_2F: 0D_2F {pinctrl-single,pins = <0x034 0x2F>;};
        B0D_37: 0D_37 {pinctrl-single,pins = <0x034 0x37>;};
        B0D_27: 0D_27 {pinctrl-single,pins = <0x034 0x27>;};
        B0D_0F: 0D_0F {pinctrl-single,pins = <0x034 0x0F>;};
        B0E_28: 0E_28 {pinctrl-single,pins = <0x038 0x28>;};
        B0E_09: 0E_09 {pinctrl-single,pins = <0x038 0x09>;};
        B0E_2A: 0E_2A {pinctrl-single,pins = <0x038 0x2A>;};
        B0E_2B: 0E_2B {pinctrl-single,pins = <0x038 0x2B>;};
        B0E_24: 0E_24 {pinctrl-single,pins = <0x038 0x24>;};
        B0E_0C: 0E_0C {pinctrl-single,pins = <0x038 0x0C>;};
        B0E_0D: 0E_0D {pinctrl-single,pins = <0x038 0x0D>;};
        B0E_26: 0E_26 {pinctrl-single,pins = <0x038 0x26>;};
        B0E_2F: 0E_2F {pinctrl-single,pins = <0x038 0x2F>;};
        B0E_37: 0E_37 {pinctrl-single,pins = <0x038 0x37>;};
        B0E_27: 0E_27 {pinctrl-single,pins = <0x038 0x27>;};
        B0E_0F: 0E_0F {pinctrl-single,pins = <0x038 0x0F>;};
        B0F_28: 0F_28 {pinctrl-single,pins = <0x03C 0x28>;};
        B0F_09: 0F_09 {pinctrl-single,pins = <0x03C 0x09>;};
        B0F_2A: 0F_2A {pinctrl-single,pins = <0x03C 0x2A>;};
        B0F_2B: 0F_2B {pinctrl-single,pins = <0x03C 0x2B>;};
        B0F_24: 0F_24 {pinctrl-single,pins = <0x03C 0x24>;};
        B0F_0C: 0F_0C {pinctrl-single,pins = <0x03C 0x0C>;};
        B0F_25: 0F_25 {pinctrl-single,pins = <0x03C 0x25>;};
        B0F_0D: 0F_0D {pinctrl-single,pins = <0x03C 0x0D>;};
        B0F_26: 0F_26 {pinctrl-single,pins = <0x03C 0x26>;};
        B0F_2F: 0F_2F {pinctrl-single,pins = <0x03C 0x2F>;};
        B0F_37: 0F_37 {pinctrl-single,pins = <0x03C 0x37>;};
        B0F_27: 0F_27 {pinctrl-single,pins = <0x03C 0x27>;};
        B0F_0F: 0F_0F {pinctrl-single,pins = <0x03C 0x0F>;};
        B10_08: 10_08 {pinctrl-single,pins = <0x040 0x08>;};
        B10_09: 10_09 {pinctrl-single,pins = <0x040 0x09>;};
        B10_0A: 10_0A {pinctrl-single,pins = <0x040 0x0A>;};
        B10_0B: 10_0B {pinctrl-single,pins = <0x040 0x0B>;};
        B10_0C: 10_0C {pinctrl-single,pins = <0x040 0x0C>;};
        B10_25: 10_25 {pinctrl-single,pins = <0x040 0x25>;};
        B10_26: 10_26 {pinctrl-single,pins = <0x040 0x26>;};
        B10_2F: 10_2F {pinctrl-single,pins = <0x040 0x2F>;};
        B10_37: 10_37 {pinctrl-single,pins = <0x040 0x37>;};
        B10_27: 10_27 {pinctrl-single,pins = <0x040 0x27>;};
        B10_0F: 10_0F {pinctrl-single,pins = <0x040 0x0F>;};
        B11_08: 11_08 {pinctrl-single,pins = <0x044 0x08>;};
        B11_21: 11_21 {pinctrl-single,pins = <0x044 0x21>;};
        B11_22: 11_22 {pinctrl-single,pins = <0x044 0x22>;};
        B11_2B: 11_2B {pinctrl-single,pins = <0x044 0x2B>;};
        B11_0C: 11_0C {pinctrl-single,pins = <0x044 0x0C>;};
        B11_0D: 11_0D {pinctrl-single,pins = <0x044 0x0D>;};
        B11_0E: 11_0E {pinctrl-single,pins = <0x044 0x0E>;};
        B11_2F: 11_2F {pinctrl-single,pins = <0x044 0x2F>;};
        B11_37: 11_37 {pinctrl-single,pins = <0x044 0x37>;};
        B11_27: 11_27 {pinctrl-single,pins = <0x044 0x27>;};
        B11_0F: 11_0F {pinctrl-single,pins = <0x044 0x0F>;};
        B12_08: 12_08 {pinctrl-single,pins = <0x048 0x08>;};
        B12_09: 12_09 {pinctrl-single,pins = <0x048 0x09>;};
        B12_0A: 12_0A {pinctrl-single,pins = <0x048 0x0A>;};
        B12_2B: 12_2B {pinctrl-single,pins = <0x048 0x2B>;};
        B12_0C: 12_0C {pinctrl-single,pins = <0x048 0x0C>;};
        B12_0D: 12_0D {pinctrl-single,pins = <0x048 0x0D>;};
        B12_0E: 12_0E {pinctrl-single,pins = <0x048 0x0E>;};
        B12_2F: 12_2F {pinctrl-single,pins = <0x048 0x2F>;};
        B12_37: 12_37 {pinctrl-single,pins = <0x048 0x37>;};
        B12_27: 12_27 {pinctrl-single,pins = <0x048 0x27>;};
        B12_0F: 12_0F {pinctrl-single,pins = <0x048 0x0F>;};
        B13_08: 13_08 {pinctrl-single,pins = <0x04C 0x08>;};
        B13_09: 13_09 {pinctrl-single,pins = <0x04C 0x09>;};
        B13_0A: 13_0A {pinctrl-single,pins = <0x04C 0x0A>;};
        B13_2B: 13_2B {pinctrl-single,pins = <0x04C 0x2B>;};
        B13_0C: 13_0C {pinctrl-single,pins = <0x04C 0x0C>;};
        B13_0D: 13_0D {pinctrl-single,pins = <0x04C 0x0D>;};
        B13_0E: 13_0E {pinctrl-single,pins = <0x04C 0x0E>;};
        B13_2F: 13_2F {pinctrl-single,pins = <0x04C 0x2F>;};
        B13_37: 13_37 {pinctrl-single,pins = <0x04C 0x37>;};
        B13_27: 13_27 {pinctrl-single,pins = <0x04C 0x27>;};
        B13_0F: 13_0F {pinctrl-single,pins = <0x04C 0x0F>;};
        B1C_20: 1C_20 {pinctrl-single,pins = <0x070 0x20>;};
        B1C_21: 1C_21 {pinctrl-single,pins = <0x070 0x21>;};
        B1C_0A: 1C_0A {pinctrl-single,pins = <0x070 0x0A>;};
        B1C_23: 1C_23 {pinctrl-single,pins = <0x070 0x23>;};
        B1C_24: 1C_24 {pinctrl-single,pins = <0x070 0x24>;};
        B1C_25: 1C_25 {pinctrl-single,pins = <0x070 0x25>;};
        B1C_26: 1C_26 {pinctrl-single,pins = <0x070 0x26>;};
        B1C_2F: 1C_2F {pinctrl-single,pins = <0x070 0x2F>;};
        B1C_37: 1C_37 {pinctrl-single,pins = <0x070 0x37>;};
        B1C_27: 1C_27 {pinctrl-single,pins = <0x070 0x27>;};
        B1C_0F: 1C_0F {pinctrl-single,pins = <0x070 0x0F>;};
        B1D_08: 1D_08 {pinctrl-single,pins = <0x074 0x08>;};
        B1D_21: 1D_21 {pinctrl-single,pins = <0x074 0x21>;};
        B1D_0A: 1D_0A {pinctrl-single,pins = <0x074 0x0A>;};
        B1D_23: 1D_23 {pinctrl-single,pins = <0x074 0x23>;};
        B1D_24: 1D_24 {pinctrl-single,pins = <0x074 0x24>;};
        B1D_0D: 1D_0D {pinctrl-single,pins = <0x074 0x0D>;};
        B1D_0E: 1D_0E {pinctrl-single,pins = <0x074 0x0E>;};
        B1D_2F: 1D_2F {pinctrl-single,pins = <0x074 0x2F>;};
        B1D_37: 1D_37 {pinctrl-single,pins = <0x074 0x37>;};
        B1D_27: 1D_27 {pinctrl-single,pins = <0x074 0x27>;};
        B1D_0F: 1D_0F {pinctrl-single,pins = <0x074 0x0F>;};
        B1E_08: 1E_08 {pinctrl-single,pins = <0x078 0x08>;};
        B1E_21: 1E_21 {pinctrl-single,pins = <0x078 0x21>;};
        B1E_0A: 1E_0A {pinctrl-single,pins = <0x078 0x0A>;};
        B1E_2B: 1E_2B {pinctrl-single,pins = <0x078 0x2B>;};
        B1E_0C: 1E_0C {pinctrl-single,pins = <0x078 0x0C>;};
        B1E_25: 1E_25 {pinctrl-single,pins = <0x078 0x25>;};
        B1E_2E: 1E_2E {pinctrl-single,pins = <0x078 0x2E>;};
        B1E_2F: 1E_2F {pinctrl-single,pins = <0x078 0x2F>;};
        B1E_37: 1E_37 {pinctrl-single,pins = <0x078 0x37>;};
        B1E_27: 1E_27 {pinctrl-single,pins = <0x078 0x27>;};
        B1E_0F: 1E_0F {pinctrl-single,pins = <0x078 0x0F>;};
        B1F_08: 1F_08 {pinctrl-single,pins = <0x07C 0x08>;};
        B1F_2F: 1F_2F {pinctrl-single,pins = <0x07C 0x2F>;};
        B1F_37: 1F_37 {pinctrl-single,pins = <0x07C 0x37>;};
        B1F_27: 1F_27 {pinctrl-single,pins = <0x07C 0x27>;};
        B1F_0F: 1F_0F {pinctrl-single,pins = <0x07C 0x0F>;};
        B23_28: 23_28 {pinctrl-single,pins = <0x08C 0x28>;};
        B23_09: 23_09 {pinctrl-single,pins = <0x08C 0x09>;};
        B23_22: 23_22 {pinctrl-single,pins = <0x08C 0x22>;};
        B23_2B: 23_2B {pinctrl-single,pins = <0x08C 0x2B>;};
        B23_24: 23_24 {pinctrl-single,pins = <0x08C 0x24>;};
        B23_0D: 23_0D {pinctrl-single,pins = <0x08C 0x0D>;};
        B23_2E: 23_2E {pinctrl-single,pins = <0x08C 0x2E>;};
        B23_2F: 23_2F {pinctrl-single,pins = <0x08C 0x2F>;};
        B23_37: 23_37 {pinctrl-single,pins = <0x08C 0x37>;};
        B23_27: 23_27 {pinctrl-single,pins = <0x08C 0x27>;};
        B23_0F: 23_0F {pinctrl-single,pins = <0x08C 0x0F>;};
        B24_08: 24_08 {pinctrl-single,pins = <0x090 0x08>;};
        B24_22: 24_22 {pinctrl-single,pins = <0x090 0x22>;};
        B24_0A: 24_0A {pinctrl-single,pins = <0x090 0x0A>;};
        B24_2F: 24_2F {pinctrl-single,pins = <0x090 0x2F>;};
        B24_37: 24_37 {pinctrl-single,pins = <0x090 0x37>;};
        B24_27: 24_27 {pinctrl-single,pins = <0x090 0x27>;};
        B24_0F: 24_0F {pinctrl-single,pins = <0x090 0x0F>;};
        B25_08: 25_08 {pinctrl-single,pins = <0x094 0x08>;};
        B25_22: 25_22 {pinctrl-single,pins = <0x094 0x22>;};
        B25_0A: 25_0A {pinctrl-single,pins = <0x094 0x0A>;};
        B25_2F: 25_2F {pinctrl-single,pins = <0x094 0x2F>;};
        B25_37: 25_37 {pinctrl-single,pins = <0x094 0x37>;};
        B25_27: 25_27 {pinctrl-single,pins = <0x094 0x27>;};
        B25_0F: 25_0F {pinctrl-single,pins = <0x094 0x0F>;};
        B26_08: 26_08 {pinctrl-single,pins = <0x098 0x08>;};
        B26_22: 26_22 {pinctrl-single,pins = <0x098 0x22>;};
        B26_0A: 26_0A {pinctrl-single,pins = <0x098 0x0A>;};
        B26_2F: 26_2F {pinctrl-single,pins = <0x098 0x2F>;};
        B26_37: 26_37 {pinctrl-single,pins = <0x098 0x37>;};
        B26_27: 26_27 {pinctrl-single,pins = <0x098 0x27>;};
        B26_0F: 26_0F {pinctrl-single,pins = <0x098 0x0F>;};
        B27_08: 27_08 {pinctrl-single,pins = <0x09C 0x08>;};
        B27_22: 27_22 {pinctrl-single,pins = <0x09C 0x22>;};
        B27_0A: 27_0A {pinctrl-single,pins = <0x09C 0x0A>;};
        B27_2F: 27_2F {pinctrl-single,pins = <0x09C 0x2F>;};
        B27_37: 27_37 {pinctrl-single,pins = <0x09C 0x37>;};
        B27_27: 27_27 {pinctrl-single,pins = <0x09C 0x27>;};
        B27_0F: 27_0F {pinctrl-single,pins = <0x09C 0x0F>;};
        B54_28: 54_28 {pinctrl-single,pins = <0x150 0x28>;};
        B54_21: 54_21 {pinctrl-single,pins = <0x150 0x21>;};
        B54_2A: 54_2A {pinctrl-single,pins = <0x150 0x2A>;};
        B54_0B: 54_0B {pinctrl-single,pins = <0x150 0x0B>;};
        B54_24: 54_24 {pinctrl-single,pins = <0x150 0x24>;};
        B54_0D: 54_0D {pinctrl-single,pins = <0x150 0x0D>;};
        B54_2E: 54_2E {pinctrl-single,pins = <0x150 0x2E>;};
        B54_2F: 54_2F {pinctrl-single,pins = <0x150 0x2F>;};
        B54_37: 54_37 {pinctrl-single,pins = <0x150 0x37>;};
        B54_27: 54_27 {pinctrl-single,pins = <0x150 0x27>;};
        B54_0F: 54_0F {pinctrl-single,pins = <0x150 0x0F>;};
        B55_28: 55_28 {pinctrl-single,pins = <0x154 0x28>;};
        B55_09: 55_09 {pinctrl-single,pins = <0x154 0x09>;};
        B55_2A: 55_2A {pinctrl-single,pins = <0x154 0x2A>;};
        B55_0B: 55_0B {pinctrl-single,pins = <0x154 0x0B>;};
        B55_0C: 55_0C {pinctrl-single,pins = <0x154 0x0C>;};
        B55_25: 55_25 {pinctrl-single,pins = <0x154 0x25>;};
        B55_2E: 55_2E {pinctrl-single,pins = <0x154 0x2E>;};
        B55_2F: 55_2F {pinctrl-single,pins = <0x154 0x2F>;};
        B55_37: 55_37 {pinctrl-single,pins = <0x154 0x37>;};
        B55_27: 55_27 {pinctrl-single,pins = <0x154 0x27>;};
        B55_0F: 55_0F {pinctrl-single,pins = <0x154 0x0F>;};
        B59_08: 59_08 {pinctrl-single,pins = <0x1A0 0x2F  0x164 0x08>;};
        B59_20: 59_20 {pinctrl-single,pins = <0x1A0 0x2F  0x164 0x20>;};
        B59_09: 59_09 {pinctrl-single,pins = <0x1A0 0x2F  0x164 0x09>;};
        B59_2A: 59_2A {pinctrl-single,pins = <0x1A0 0x2F  0x164 0x2A>;};
        B59_23: 59_23 {pinctrl-single,pins = <0x1A0 0x2F  0x164 0x23>;};
        B59_0B: 59_0B {pinctrl-single,pins = <0x1A0 0x2F  0x164 0x0B>;};
        B59_2C: 59_2C {pinctrl-single,pins = <0x1A0 0x2F  0x164 0x2C>;};
        B59_25: 59_25 {pinctrl-single,pins = <0x1A0 0x2F  0x164 0x25>;};
        B59_26: 59_26 {pinctrl-single,pins = <0x1A0 0x2F  0x164 0x26>;};
        B59_2F: 59_2F {pinctrl-single,pins = <0x1A0 0x2F  0x164 0x2F>;};
        B59_37: 59_37 {pinctrl-single,pins = <0x1A0 0x2F  0x164 0x37>;};
        B59_27: 59_27 {pinctrl-single,pins = <0x1A0 0x2F  0x164 0x27>;};
        B59_0F: 59_0F {pinctrl-single,pins = <0x1A0 0x2F  0x164 0x0F>;};
        B60_20: 60_20 {pinctrl-single,pins = <0x180 0x20>;};
        B60_21: 60_21 {pinctrl-single,pins = <0x180 0x21>;};
        B60_0A: 60_0A {pinctrl-single,pins = <0x180 0x0A>;};
        B60_2B: 60_2B {pinctrl-single,pins = <0x180 0x2B>;};
        B60_25: 60_25 {pinctrl-single,pins = <0x180 0x25>;};
        B60_26: 60_26 {pinctrl-single,pins = <0x180 0x26>;};
        B60_2F: 60_2F {pinctrl-single,pins = <0x180 0x2F>;};
        B60_37: 60_37 {pinctrl-single,pins = <0x180 0x37>;};
        B60_27: 60_27 {pinctrl-single,pins = <0x180 0x27>;};
        B60_0F: 60_0F {pinctrl-single,pins = <0x180 0x0F>;};
        B61_08: 61_08 {pinctrl-single,pins = <0x184 0x08>;};
        B61_21: 61_21 {pinctrl-single,pins = <0x184 0x21>;};
        B61_22: 61_22 {pinctrl-single,pins = <0x184 0x22>;};
        B61_2B: 61_2B {pinctrl-single,pins = <0x184 0x2B>;};
        B61_0D: 61_0D {pinctrl-single,pins = <0x184 0x0D>;};
        B61_26: 61_26 {pinctrl-single,pins = <0x184 0x26>;};
        B61_2F: 61_2F {pinctrl-single,pins = <0x184 0x2F>;};
        B61_37: 61_37 {pinctrl-single,pins = <0x184 0x37>;};
        B61_27: 61_27 {pinctrl-single,pins = <0x184 0x27>;};
        B61_0F: 61_0F {pinctrl-single,pins = <0x184 0x0F>;};
        B66_28: 66_28 {pinctrl-single,pins = <0x198 0x28>;};
        B66_21: 66_21 {pinctrl-single,pins = <0x198 0x21>;};
        B66_2B: 66_2B {pinctrl-single,pins = <0x198 0x2B>;};
        B66_24: 66_24 {pinctrl-single,pins = <0x198 0x24>;};
        B66_0D: 66_0D {pinctrl-single,pins = <0x198 0x0D>;};
        B66_26: 66_26 {pinctrl-single,pins = <0x198 0x26>;};
        B66_2F: 66_2F {pinctrl-single,pins = <0x198 0x2F>;};
        B66_37: 66_37 {pinctrl-single,pins = <0x198 0x37>;};
        B66_27: 66_27 {pinctrl-single,pins = <0x198 0x27>;};
        B66_0F: 66_0F {pinctrl-single,pins = <0x198 0x0F>;};
        B68_28: 68_28 {pinctrl-single,pins = <0x164 0x2F  0x1A0 0x28>;};
        B68_21: 68_21 {pinctrl-single,pins = <0x164 0x2F  0x1A0 0x21>;};
        B68_2A: 68_2A {pinctrl-single,pins = <0x164 0x2F  0x1A0 0x2A>;};
        B68_2B: 68_2B {pinctrl-single,pins = <0x164 0x2F  0x1A0 0x2B>;};
        B68_24: 68_24 {pinctrl-single,pins = <0x164 0x2F  0x1A0 0x24>;};
        B68_0D: 68_0D {pinctrl-single,pins = <0x164 0x2F  0x1A0 0x0D>;};
        B68_26: 68_26 {pinctrl-single,pins = <0x164 0x2F  0x1A0 0x26>;};
        B68_2F: 68_2F {pinctrl-single,pins = <0x164 0x2F  0x1A0 0x2F>;};
        B68_37: 68_37 {pinctrl-single,pins = <0x164 0x2F  0x1A0 0x37>;};
        B68_27: 68_27 {pinctrl-single,pins = <0x164 0x2F  0x1A0 0x27>;};
        B68_0F: 68_0F {pinctrl-single,pins = <0x164 0x2F  0x1A0 0x0F>;};
        B69_28: 69_28 {pinctrl-single,pins = <0x1A4 0x28>;};
        B69_21: 69_21 {pinctrl-single,pins = <0x1A4 0x21>;};
        B69_2A: 69_2A {pinctrl-single,pins = <0x1A4 0x2A>;};
        B69_2B: 69_2B {pinctrl-single,pins = <0x1A4 0x2B>;};
        B69_2C: 69_2C {pinctrl-single,pins = <0x1A4 0x2C>;};
        B69_0D: 69_0D {pinctrl-single,pins = <0x1A4 0x0D>;};
        B69_26: 69_26 {pinctrl-single,pins = <0x1A4 0x26>;};
        B69_2F: 69_2F {pinctrl-single,pins = <0x1A4 0x2F>;};
        B69_37: 69_37 {pinctrl-single,pins = <0x1A4 0x37>;};
        B69_27: 69_27 {pinctrl-single,pins = <0x1A4 0x27>;};
        B69_0F: 69_0F {pinctrl-single,pins = <0x1A4 0x0F>;};
        B6A_28: 6A_28 {pinctrl-single,pins = <0x1B4 0x2F  0x1A8 0x28>;};
        B6A_21: 6A_21 {pinctrl-single,pins = <0x1B4 0x2F  0x1A8 0x21>;};
        B6A_09: 6A_09 {pinctrl-single,pins = <0x1B4 0x2F  0x1A8 0x09>;};
        B6A_2B: 6A_2B {pinctrl-single,pins = <0x1B4 0x2F  0x1A8 0x2B>;};
        B6A_2C: 6A_2C {pinctrl-single,pins = <0x1B4 0x2F  0x1A8 0x2C>;};
        B6A_0D: 6A_0D {pinctrl-single,pins = <0x1B4 0x2F  0x1A8 0x0D>;};
        B6A_26: 6A_26 {pinctrl-single,pins = <0x1B4 0x2F  0x1A8 0x26>;};
        B6A_2F: 6A_2F {pinctrl-single,pins = <0x1B4 0x2F  0x1A8 0x2F>;};
        B6A_37: 6A_37 {pinctrl-single,pins = <0x1B4 0x2F  0x1A8 0x37>;};
        B6A_27: 6A_27 {pinctrl-single,pins = <0x1B4 0x2F  0x1A8 0x27>;};
        B6A_0F: 6A_0F {pinctrl-single,pins = <0x1B4 0x2F  0x1A8 0x0F>;};
        B6D_20: 6D_20 {pinctrl-single,pins = <0x1B4 0x20>;};
        B6D_22: 6D_22 {pinctrl-single,pins = <0x1B4 0x22>;};
        B6D_0B: 6D_0B {pinctrl-single,pins = <0x1B4 0x0B>;};
        B6D_24: 6D_24 {pinctrl-single,pins = <0x1B4 0x24>;};
        B6D_0C: 6D_0C {pinctrl-single,pins = <0x1B4 0x0C>;};
        B6D_25: 6D_25 {pinctrl-single,pins = <0x1B4 0x25>;};
        B6D_2E: 6D_2E {pinctrl-single,pins = <0x1B4 0x2E>;};
        B6D_2F: 6D_2F {pinctrl-single,pins = <0x1B4 0x2F>;};
        B6D_37: 6D_37 {pinctrl-single,pins = <0x1B4 0x37>;};
        B6D_27: 6D_27 {pinctrl-single,pins = <0x1B4 0x27>;};
        B6D_0F: 6D_0F {pinctrl-single,pins = <0x1B4 0x0F>;};
      };
    };
    fragment@1 {
      target = <&ocp>;
      __overlay__ {
        pruio-08 {
          compatible = "bone-pinmux-helper";
          status = "okay";
          pinctrl-names = "x28", "x09", "x2A", "x2B", "x0C", "x25", "x2F", "x37", "x27", "x0F";
          pinctrl-0 = <&B08_28>;
          pinctrl-1 = <&B08_09>;
          pinctrl-2 = <&B08_2A>;
          pinctrl-3 = <&B08_2B>;
          pinctrl-4 = <&B08_0C>;
          pinctrl-5 = <&B08_25>;
          pinctrl-6 = <&B08_2F>;
          pinctrl-7 = <&B08_37>;
          pinctrl-8 = <&B08_27>;
          pinctrl-9 = <&B08_0F>;
        };
        pruio-09 {
          compatible = "bone-pinmux-helper";
          status = "okay";
          pinctrl-names = "x28", "x09", "x2A", "x2B", "x0C", "x25", "x2F", "x37", "x27", "x0F";
          pinctrl-0 = <&B09_28>;
          pinctrl-1 = <&B09_09>;
          pinctrl-2 = <&B09_2A>;
          pinctrl-3 = <&B09_2B>;
          pinctrl-4 = <&B09_0C>;
          pinctrl-5 = <&B09_25>;
          pinctrl-6 = <&B09_2F>;
          pinctrl-7 = <&B09_37>;
          pinctrl-8 = <&B09_27>;
          pinctrl-9 = <&B09_0F>;
        };
        pruio-0A {
          compatible = "bone-pinmux-helper";
          status = "okay";
          pinctrl-names = "x28", "x09", "x2A", "x2B", "x24", "x0D", "x2F", "x37", "x27", "x0F";
          pinctrl-0 = <&B0A_28>;
          pinctrl-1 = <&B0A_09>;
          pinctrl-2 = <&B0A_2A>;
          pinctrl-3 = <&B0A_2B>;
          pinctrl-4 = <&B0A_24>;
          pinctrl-5 = <&B0A_0D>;
          pinctrl-6 = <&B0A_2F>;
          pinctrl-7 = <&B0A_37>;
          pinctrl-8 = <&B0A_27>;
          pinctrl-9 = <&B0A_0F>;
        };
        pruio-0B {
          compatible = "bone-pinmux-helper";
          status = "okay";
          pinctrl-names = "x28", "x09", "x2A", "x2B", "x0C", "x0D", "x2F", "x37", "x27", "x0F";
          pinctrl-0 = <&B0B_28>;
          pinctrl-1 = <&B0B_09>;
          pinctrl-2 = <&B0B_2A>;
          pinctrl-3 = <&B0B_2B>;
          pinctrl-4 = <&B0B_0C>;
          pinctrl-5 = <&B0B_0D>;
          pinctrl-6 = <&B0B_2F>;
          pinctrl-7 = <&B0B_37>;
          pinctrl-8 = <&B0B_27>;
          pinctrl-9 = <&B0B_0F>;
        };
        pruio-0C {
          compatible = "bone-pinmux-helper";
          status = "okay";
          pinctrl-names = "x28", "x09", "x2A", "x2B", "x24", "x0D", "x0E", "x2F", "x37", "x27", "x0F";
          pinctrl-0 = <&B0C_28>;
          pinctrl-1 = <&B0C_09>;
          pinctrl-2 = <&B0C_2A>;
          pinctrl-3 = <&B0C_2B>;
          pinctrl-4 = <&B0C_24>;
          pinctrl-5 = <&B0C_0D>;
          pinctrl-6 = <&B0C_0E>;
          pinctrl-7 = <&B0C_2F>;
          pinctrl-8 = <&B0C_37>;
          pinctrl-9 = <&B0C_27>;
          pinctrl-10 = <&B0C_0F>;
        };
        pruio-0D {
          compatible = "bone-pinmux-helper";
          status = "okay";
          pinctrl-names = "x28", "x09", "x2A", "x2B", "x24", "x0D", "x0E", "x2F", "x37", "x27", "x0F";
          pinctrl-0 = <&B0D_28>;
          pinctrl-1 = <&B0D_09>;
          pinctrl-2 = <&B0D_2A>;
          pinctrl-3 = <&B0D_2B>;
          pinctrl-4 = <&B0D_24>;
          pinctrl-5 = <&B0D_0D>;
          pinctrl-6 = <&B0D_0E>;
          pinctrl-7 = <&B0D_2F>;
          pinctrl-8 = <&B0D_37>;
          pinctrl-9 = <&B0D_27>;
          pinctrl-10 = <&B0D_0F>;
        };
        pruio-0E {
          compatible = "bone-pinmux-helper";
          status = "okay";
          pinctrl-names = "x28", "x09", "x2A", "x2B", "x24", "x0C", "x0D", "x26", "x2F", "x37", "x27", "x0F";
          pinctrl-0 = <&B0E_28>;
          pinctrl-1 = <&B0E_09>;
          pinctrl-2 = <&B0E_2A>;
          pinctrl-3 = <&B0E_2B>;
          pinctrl-4 = <&B0E_24>;
          pinctrl-5 = <&B0E_0C>;
          pinctrl-6 = <&B0E_0D>;
          pinctrl-7 = <&B0E_26>;
          pinctrl-8 = <&B0E_2F>;
          pinctrl-9 = <&B0E_37>;
          pinctrl-10 = <&B0E_27>;
          pinctrl-11 = <&B0E_0F>;
        };
        pruio-0F {
          compatible = "bone-pinmux-helper";
          status = "okay";
          pinctrl-names = "x28", "x09", "x2A", "x2B", "x24", "x0C", "x25", "x0D", "x26", "x2F", "x37", "x27", "x0F";
          pinctrl-0 = <&B0F_28>;
          pinctrl-1 = <&B0F_09>;
          pinctrl-2 = <&B0F_2A>;
          pinctrl-3 = <&B0F_2B>;
          pinctrl-4 = <&B0F_24>;
          pinctrl-5 = <&B0F_0C>;
          pinctrl-6 = <&B0F_25>;
          pinctrl-7 = <&B0F_0D>;
          pinctrl-8 = <&B0F_26>;
          pinctrl-9 = <&B0F_2F>;
          pinctrl-10 = <&B0F_37>;
          pinctrl-11 = <&B0F_27>;
          pinctrl-12 = <&B0F_0F>;
        };
        pruio-10 {
          compatible = "bone-pinmux-helper";
          status = "okay";
          pinctrl-names = "x08", "x09", "x0A", "x0B", "x0C", "x25", "x26", "x2F", "x37", "x27", "x0F";
          pinctrl-0 = <&B10_08>;
          pinctrl-1 = <&B10_09>;
          pinctrl-2 = <&B10_0A>;
          pinctrl-3 = <&B10_0B>;
          pinctrl-4 = <&B10_0C>;
          pinctrl-5 = <&B10_25>;
          pinctrl-6 = <&B10_26>;
          pinctrl-7 = <&B10_2F>;
          pinctrl-8 = <&B10_37>;
          pinctrl-9 = <&B10_27>;
          pinctrl-10 = <&B10_0F>;
        };
        pruio-11 {
          compatible = "bone-pinmux-helper";
          status = "okay";
          pinctrl-names = "x08", "x21", "x22", "x2B", "x0C", "x0D", "x0E", "x2F", "x37", "x27", "x0F";
          pinctrl-0 = <&B11_08>;
          pinctrl-1 = <&B11_21>;
          pinctrl-2 = <&B11_22>;
          pinctrl-3 = <&B11_2B>;
          pinctrl-4 = <&B11_0C>;
          pinctrl-5 = <&B11_0D>;
          pinctrl-6 = <&B11_0E>;
          pinctrl-7 = <&B11_2F>;
          pinctrl-8 = <&B11_37>;
          pinctrl-9 = <&B11_27>;
          pinctrl-10 = <&B11_0F>;
        };
        pruio-12 {
          compatible = "bone-pinmux-helper";
          status = "okay";
          pinctrl-names = "x08", "x09", "x0A", "x2B", "x0C", "x0D", "x0E", "x2F", "x37", "x27", "x0F";
          pinctrl-0 = <&B12_08>;
          pinctrl-1 = <&B12_09>;
          pinctrl-2 = <&B12_0A>;
          pinctrl-3 = <&B12_2B>;
          pinctrl-4 = <&B12_0C>;
          pinctrl-5 = <&B12_0D>;
          pinctrl-6 = <&B12_0E>;
          pinctrl-7 = <&B12_2F>;
          pinctrl-8 = <&B12_37>;
          pinctrl-9 = <&B12_27>;
          pinctrl-10 = <&B12_0F>;
        };
        pruio-13 {
          compatible = "bone-pinmux-helper";
          status = "okay";
          pinctrl-names = "x08", "x09", "x0A", "x2B", "x0C", "x0D", "x0E", "x2F", "x37", "x27", "x0F";
          pinctrl-0 = <&B13_08>;
          pinctrl-1 = <&B13_09>;
          pinctrl-2 = <&B13_0A>;
          pinctrl-3 = <&B13_2B>;
          pinctrl-4 = <&B13_0C>;
          pinctrl-5 = <&B13_0D>;
          pinctrl-6 = <&B13_0E>;
          pinctrl-7 = <&B13_2F>;
          pinctrl-8 = <&B13_37>;
          pinctrl-9 = <&B13_27>;
          pinctrl-10 = <&B13_0F>;
        };
        pruio-1C {
          compatible = "bone-pinmux-helper";
          status = "okay";
          pinctrl-names = "x20", "x21", "x0A", "x23", "x24", "x25", "x26", "x2F", "x37", "x27", "x0F";
          pinctrl-0 = <&B1C_20>;
          pinctrl-1 = <&B1C_21>;
          pinctrl-2 = <&B1C_0A>;
          pinctrl-3 = <&B1C_23>;
          pinctrl-4 = <&B1C_24>;
          pinctrl-5 = <&B1C_25>;
          pinctrl-6 = <&B1C_26>;
          pinctrl-7 = <&B1C_2F>;
          pinctrl-8 = <&B1C_37>;
          pinctrl-9 = <&B1C_27>;
          pinctrl-10 = <&B1C_0F>;
        };
        pruio-1D {
          compatible = "bone-pinmux-helper";
          status = "okay";
          pinctrl-names = "x08", "x21", "x0A", "x23", "x24", "x0D", "x0E", "x2F", "x37", "x27", "x0F";
          pinctrl-0 = <&B1D_08>;
          pinctrl-1 = <&B1D_21>;
          pinctrl-2 = <&B1D_0A>;
          pinctrl-3 = <&B1D_23>;
          pinctrl-4 = <&B1D_24>;
          pinctrl-5 = <&B1D_0D>;
          pinctrl-6 = <&B1D_0E>;
          pinctrl-7 = <&B1D_2F>;
          pinctrl-8 = <&B1D_37>;
          pinctrl-9 = <&B1D_27>;
          pinctrl-10 = <&B1D_0F>;
        };
        pruio-1E {
          compatible = "bone-pinmux-helper";
          status = "okay";
          pinctrl-names = "x08", "x21", "x0A", "x2B", "x0C", "x25", "x2E", "x2F", "x37", "x27", "x0F";
          pinctrl-0 = <&B1E_08>;
          pinctrl-1 = <&B1E_21>;
          pinctrl-2 = <&B1E_0A>;
          pinctrl-3 = <&B1E_2B>;
          pinctrl-4 = <&B1E_0C>;
          pinctrl-5 = <&B1E_25>;
          pinctrl-6 = <&B1E_2E>;
          pinctrl-7 = <&B1E_2F>;
          pinctrl-8 = <&B1E_37>;
          pinctrl-9 = <&B1E_27>;
          pinctrl-10 = <&B1E_0F>;
        };
        pruio-1F {
          compatible = "bone-pinmux-helper";
          status = "okay";
          pinctrl-names = "x08", "x2F", "x37", "x27", "x0F";
          pinctrl-0 = <&B1F_08>;
          pinctrl-1 = <&B1F_2F>;
          pinctrl-2 = <&B1F_37>;
          pinctrl-3 = <&B1F_27>;
          pinctrl-4 = <&B1F_0F>;
        };
        pruio-23 {
          compatible = "bone-pinmux-helper";
          status = "okay";
          pinctrl-names = "x28", "x09", "x22", "x2B", "x24", "x0D", "x2E", "x2F", "x37", "x27", "x0F";
          pinctrl-0 = <&B23_28>;
          pinctrl-1 = <&B23_09>;
          pinctrl-2 = <&B23_22>;
          pinctrl-3 = <&B23_2B>;
          pinctrl-4 = <&B23_24>;
          pinctrl-5 = <&B23_0D>;
          pinctrl-6 = <&B23_2E>;
          pinctrl-7 = <&B23_2F>;
          pinctrl-8 = <&B23_37>;
          pinctrl-9 = <&B23_27>;
          pinctrl-10 = <&B23_0F>;
        };
        pruio-24 {
          compatible = "bone-pinmux-helper";
          status = "okay";
          pinctrl-names = "x08", "x22", "x0A", "x2F", "x37", "x27", "x0F";
          pinctrl-0 = <&B24_08>;
          pinctrl-1 = <&B24_22>;
          pinctrl-2 = <&B24_0A>;
          pinctrl-3 = <&B24_2F>;
          pinctrl-4 = <&B24_37>;
          pinctrl-5 = <&B24_27>;
          pinctrl-6 = <&B24_0F>;
        };
        pruio-25 {
          compatible = "bone-pinmux-helper";
          status = "okay";
          pinctrl-names = "x08", "x22", "x0A", "x2F", "x37", "x27", "x0F";
          pinctrl-0 = <&B25_08>;
          pinctrl-1 = <&B25_22>;
          pinctrl-2 = <&B25_0A>;
          pinctrl-3 = <&B25_2F>;
          pinctrl-4 = <&B25_37>;
          pinctrl-5 = <&B25_27>;
          pinctrl-6 = <&B25_0F>;
        };
        pruio-26 {
          compatible = "bone-pinmux-helper";
          status = "okay";
          pinctrl-names = "x08", "x22", "x0A", "x2F", "x37", "x27", "x0F";
          pinctrl-0 = <&B26_08>;
          pinctrl-1 = <&B26_22>;
          pinctrl-2 = <&B26_0A>;
          pinctrl-3 = <&B26_2F>;
          pinctrl-4 = <&B26_37>;
          pinctrl-5 = <&B26_27>;
          pinctrl-6 = <&B26_0F>;
        };
        pruio-27 {
          compatible = "bone-pinmux-helper";
          status = "okay";
          pinctrl-names = "x08", "x22", "x0A", "x2F", "x37", "x27", "x0F";
          pinctrl-0 = <&B27_08>;
          pinctrl-1 = <&B27_22>;
          pinctrl-2 = <&B27_0A>;
          pinctrl-3 = <&B27_2F>;
          pinctrl-4 = <&B27_37>;
          pinctrl-5 = <&B27_27>;
          pinctrl-6 = <&B27_0F>;
        };
        pruio-54 {
          compatible = "bone-pinmux-helper";
          status = "okay";
          pinctrl-names = "x28", "x21", "x2A", "x0B", "x24", "x0D", "x2E", "x2F", "x37", "x27", "x0F";
          pinctrl-0 = <&B54_28>;
          pinctrl-1 = <&B54_21>;
          pinctrl-2 = <&B54_2A>;
          pinctrl-3 = <&B54_0B>;
          pinctrl-4 = <&B54_24>;
          pinctrl-5 = <&B54_0D>;
          pinctrl-6 = <&B54_2E>;
          pinctrl-7 = <&B54_2F>;
          pinctrl-8 = <&B54_37>;
          pinctrl-9 = <&B54_27>;
          pinctrl-10 = <&B54_0F>;
        };
        pruio-55 {
          compatible = "bone-pinmux-helper";
          status = "okay";
          pinctrl-names = "x28", "x09", "x2A", "x0B", "x0C", "x25", "x2E", "x2F", "x37", "x27", "x0F";
          pinctrl-0 = <&B55_28>;
          pinctrl-1 = <&B55_09>;
          pinctrl-2 = <&B55_2A>;
          pinctrl-3 = <&B55_0B>;
          pinctrl-4 = <&B55_0C>;
          pinctrl-5 = <&B55_25>;
          pinctrl-6 = <&B55_2E>;
          pinctrl-7 = <&B55_2F>;
          pinctrl-8 = <&B55_37>;
          pinctrl-9 = <&B55_27>;
          pinctrl-10 = <&B55_0F>;
        };
        pruio-59 {
          compatible = "bone-pinmux-helper";
          status = "okay";
          pinctrl-names = "x08", "x20", "x09", "x2A", "x23", "x0B", "x2C", "x25", "x26", "x2F", "x37", "x27", "x0F";
          pinctrl-0 = <&B59_08>;
          pinctrl-1 = <&B59_20>;
          pinctrl-2 = <&B59_09>;
          pinctrl-3 = <&B59_2A>;
          pinctrl-4 = <&B59_23>;
          pinctrl-5 = <&B59_0B>;
          pinctrl-6 = <&B59_2C>;
          pinctrl-7 = <&B59_25>;
          pinctrl-8 = <&B59_26>;
          pinctrl-9 = <&B59_2F>;
          pinctrl-10 = <&B59_37>;
          pinctrl-11 = <&B59_27>;
          pinctrl-12 = <&B59_0F>;
        };
        pruio-60 {
          compatible = "bone-pinmux-helper";
          status = "okay";
          pinctrl-names = "x20", "x21", "x0A", "x2B", "x25", "x26", "x2F", "x37", "x27", "x0F";
          pinctrl-0 = <&B60_20>;
          pinctrl-1 = <&B60_21>;
          pinctrl-2 = <&B60_0A>;
          pinctrl-3 = <&B60_2B>;
          pinctrl-4 = <&B60_25>;
          pinctrl-5 = <&B60_26>;
          pinctrl-6 = <&B60_2F>;
          pinctrl-7 = <&B60_37>;
          pinctrl-8 = <&B60_27>;
          pinctrl-9 = <&B60_0F>;
        };
        pruio-61 {
          compatible = "bone-pinmux-helper";
          status = "okay";
          pinctrl-names = "x08", "x21", "x22", "x2B", "x0D", "x26", "x2F", "x37", "x27", "x0F";
          pinctrl-0 = <&B61_08>;
          pinctrl-1 = <&B61_21>;
          pinctrl-2 = <&B61_22>;
          pinctrl-3 = <&B61_2B>;
          pinctrl-4 = <&B61_0D>;
          pinctrl-5 = <&B61_26>;
          pinctrl-6 = <&B61_2F>;
          pinctrl-7 = <&B61_37>;
          pinctrl-8 = <&B61_27>;
          pinctrl-9 = <&B61_0F>;
        };
        pruio-66 {
          compatible = "bone-pinmux-helper";
          status = "okay";
          pinctrl-names = "x28", "x21", "x2B", "x24", "x0D", "x26", "x2F", "x37", "x27", "x0F";
          pinctrl-0 = <&B66_28>;
          pinctrl-1 = <&B66_21>;
          pinctrl-2 = <&B66_2B>;
          pinctrl-3 = <&B66_24>;
          pinctrl-4 = <&B66_0D>;
          pinctrl-5 = <&B66_26>;
          pinctrl-6 = <&B66_2F>;
          pinctrl-7 = <&B66_37>;
          pinctrl-8 = <&B66_27>;
          pinctrl-9 = <&B66_0F>;
        };
        pruio-68 {
          compatible = "bone-pinmux-helper";
          status = "okay";
          pinctrl-names = "x28", "x21", "x2A", "x2B", "x24", "x0D", "x26", "x2F", "x37", "x27", "x0F";
          pinctrl-0 = <&B68_28>;
          pinctrl-1 = <&B68_21>;
          pinctrl-2 = <&B68_2A>;
          pinctrl-3 = <&B68_2B>;
          pinctrl-4 = <&B68_24>;
          pinctrl-5 = <&B68_0D>;
          pinctrl-6 = <&B68_26>;
          pinctrl-7 = <&B68_2F>;
          pinctrl-8 = <&B68_37>;
          pinctrl-9 = <&B68_27>;
          pinctrl-10 = <&B68_0F>;
        };
        pruio-69 {
          compatible = "bone-pinmux-helper";
          status = "okay";
          pinctrl-names = "x28", "x21", "x2A", "x2B", "x2C", "x0D", "x26", "x2F", "x37", "x27", "x0F";
          pinctrl-0 = <&B69_28>;
          pinctrl-1 = <&B69_21>;
          pinctrl-2 = <&B69_2A>;
          pinctrl-3 = <&B69_2B>;
          pinctrl-4 = <&B69_2C>;
          pinctrl-5 = <&B69_0D>;
          pinctrl-6 = <&B69_26>;
          pinctrl-7 = <&B69_2F>;
          pinctrl-8 = <&B69_37>;
          pinctrl-9 = <&B69_27>;
          pinctrl-10 = <&B69_0F>;
        };
        pruio-6A {
          compatible = "bone-pinmux-helper";
          status = "okay";
          pinctrl-names = "x28", "x21", "x09", "x2B", "x2C", "x0D", "x26", "x2F", "x37", "x27", "x0F";
          pinctrl-0 = <&B6A_28>;
          pinctrl-1 = <&B6A_21>;
          pinctrl-2 = <&B6A_09>;
          pinctrl-3 = <&B6A_2B>;
          pinctrl-4 = <&B6A_2C>;
          pinctrl-5 = <&B6A_0D>;
          pinctrl-6 = <&B6A_26>;
          pinctrl-7 = <&B6A_2F>;
          pinctrl-8 = <&B6A_37>;
          pinctrl-9 = <&B6A_27>;
          pinctrl-10 = <&B6A_0F>;
        };
        pruio-6D {
          compatible = "bone-pinmux-helper";
          status = "okay";
          pinctrl-names = "x20", "x22", "x0B", "x24", "x0C", "x25", "x2E", "x2F", "x37", "x27", "x0F";
          pinctrl-0 = <&B6D_20>;
          pinctrl-1 = <&B6D_22>;
          pinctrl-2 = <&B6D_0B>;
          pinctrl-3 = <&B6D_24>;
          pinctrl-4 = <&B6D_0C>;
          pinctrl-5 = <&B6D_25>;
          pinctrl-6 = <&B6D_2E>;
          pinctrl-7 = <&B6D_2F>;
          pinctrl-8 = <&B6D_37>;
          pinctrl-9 = <&B6D_27>;
          pinctrl-10 = <&B6D_0F>;
        };
      };
    };
    fragment@2 {
      target = <&pruss>;
      __overlay__ {
          status = "okay";
      };
    };
  };